## conf/layer.conf
```bitbake
BBPATH .= ":${LAYERDIR}"

BBFILES += "${LAYERDIR}/recipes-*/*/*.bb \
            ${LAYERDIR}/recipes-*/*/*.bbappend"

BBFILE_COLLECTIONS += "rtl83xx-bsp"
BBFILE_PATTERN_rtl83xx-bsp = "^${LAYERDIR}/"
BBFILE_PRIORITY_rtl83xx-bsp = "6"

LAYERDEPENDS_rtl83xx-bsp = "core"
LAYERSERIES_COMPAT_rtl83xx-bsp = "wrynose"

ERROR_QA:remove = "patch-status"
```
